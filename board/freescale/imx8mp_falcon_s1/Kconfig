## board/freescale/imx8mp_falcon_s1/Kconfig
```kconfig
config SYS_BOARD
	default "imx8mp_falcon_s1"

config SYS_VENDOR
	default "freescale"

config SYS_CONFIG_NAME
	default "imx8mp_falcon_s1"

config IMX_CONFIG
	default "board/freescale/imx8mp_falcon_s1/imximage-8mp-lpddr4.cfg"
```
